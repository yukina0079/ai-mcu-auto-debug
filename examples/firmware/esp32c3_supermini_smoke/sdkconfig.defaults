## examples/firmware/esp32c3_supermini_smoke/sdkconfig.defaults
```kconfig
CONFIG_IDF_TARGET="esp32c3"
CONFIG_ESP_CONSOLE_USB_SERIAL_JTAG=y
CONFIG_ESP_CONSOLE_UART_DEFAULT=n
CONFIG_LOG_DEFAULT_LEVEL_INFO=y
```
